## Kconfig
```kconfig
# Copyright (c) 2026 The ZMK Contributors
# SPDX-License-Identifier: MIT

menuconfig ZMK_SPLIT_ESB
    bool "ESB split transport"
    depends on ZMK_SPLIT
    help
      Enhanced ShockBurst link between split halves. On a central that also
      runs BLE, the ESB receiver is hosted inside Zephyr's open-source BLE
      controller so BLE to hosts keeps working.

if ZMK_SPLIT_ESB

config ZMK_SPLIT_ESB_HOSTED_PRX
    bool "Host the ESB receiver inside the Zephyr BLE controller"
    default y if ZMK_SPLIT_ROLE_CENTRAL && BT_LL_SW_SPLIT
    depends on BT_LL_SW_SPLIT
    select BT_CTLR_USER_EXT
    select BT_CTLR_ASSERT_HANDLER
    select ZMK_SPLIT_ESB_ASSERT_RECORD

config ZMK_SPLIT_ESB_PRX_AUTOSTART
    bool "Start listening as soon as the controller initialises"
    depends on ZMK_SPLIT_ESB_HOSTED_PRX
    default y

config ZMK_SPLIT_ESB_PRX_TICKER_INTERVAL_MS
    int "Period of the receiver's scheduler ticker (ms)"
    depends on ZMK_SPLIT_ESB_HOSTED_PRX
    default 100
    help
      The receiver keeps listening across ticker periods and is resumed
      after every BLE event, so this only bounds how long it can stay off
      the air if a resume is ever lost.

config ZMK_SPLIT_ESB_PTX
    bool "Standalone ESB transmitter (peripheral without BLE)"
    default y if !ZMK_SPLIT_ROLE_CENTRAL
    depends on !ZMK_SPLIT_ROLE_CENTRAL && !BT_CTLR
    select CLOCK_CONTROL

config ZMK_SPLIT_ESB_PERIPHERAL_ID
    int "Peripheral id, which is also its ESB pipe"
    depends on ZMK_SPLIT_ESB_PTX
    range 1 7
    default 1

config ZMK_SPLIT_ESB_PTX_RETRANSMIT_COUNT
    int "Retransmissions before a packet is given up on"
    depends on ZMK_SPLIT_ESB_PTX
    default 10

config ZMK_SPLIT_ESB_PTX_RETRANSMIT_DELAY_US
    int "Delay between retransmissions (us)"
    depends on ZMK_SPLIT_ESB_PTX
    default 500

config ZMK_SPLIT_ESB_TEST_PTX
    bool "Send a counter packet every few ms (phase 1 test traffic)"
    depends on ZMK_SPLIT_ESB_PTX

config ZMK_SPLIT_ESB_TEST_PTX_INTERVAL_MS
    int "Test packet interval (ms)"
    depends on ZMK_SPLIT_ESB_TEST_PTX
    default 10

config ZMK_SPLIT_ESB_RF_CHANNEL
    int "RF channel (2400 MHz + n)"
    range 0 100
    default 74
    help
      The default sits above Wi-Fi channel 11 and away from the BLE
      advertising channels (2402, 2426, 2480 MHz).

config ZMK_SPLIT_ESB_TX_POWER_DBM
    int "TX power (dBm): 8, 4, 0, -4 or -8"
    default 4

config ZMK_SPLIT_ESB_BASE_ADDR0
    hex "ESB base address 0 (pipe 0)"
    default 0xE7E7E7E7

config ZMK_SPLIT_ESB_BASE_ADDR1
    hex "ESB base address 1 (pipes 1-7)"
    default 0xC2C2C2C2
    help
      Change this, or the prefixes, per keyboard so two keyboards nearby
      don't hear each other.

config ZMK_SPLIT_ESB_ADDR_PREFIX0
    hex "Address prefixes for pipes 3..0 (low byte is pipe 0)"
    default 0xC4C3C2E7

config ZMK_SPLIT_ESB_ADDR_PREFIX1
    hex "Address prefixes for pipes 7..4 (low byte is pipe 4)"
    default 0xC8C7C6C5

config ZMK_SPLIT_ESB_ASSERT_RECORD
    bool "Keep the last controller assert across a reboot"
    select REBOOT
    help
      Controller asserts are written to RAM that survives a warm reset, then
      the keyboard reboots. The debug screen shows the recorded file and line.

config ZMK_SPLIT_ESB_SELFTEST_ASSERT
    bool "Fire one fake controller assert 30 s after boot"
    depends on ZMK_SPLIT_ESB_ASSERT_RECORD
    help
      Test aid for the assert record: if no assert has been recorded yet, raise
      one and reboot, so the debug screen should then show it.

config ZMK_SPLIT_ESB_DEBUG_SCREEN
    bool "ESB debug status screen for nice!view"
    depends on ZMK_DISPLAY && ZMK_DISPLAY_STATUS_SCREEN_CUSTOM
    select LV_USE_CANVAS
    select LV_FONT_UNSCII_8
    select HWINFO
    help
      Replaces the status screen with link counters. Build with
      CONFIG_NICE_VIEW_WIDGET_STATUS=n so the stock nice!view screen is
      left out.

config ZMK_SPLIT_ESB_DEBUG_SCREEN_REFRESH_MS
    int "Debug screen refresh period (ms)"
    depends on ZMK_SPLIT_ESB_DEBUG_SCREEN
    default 500

module = ZMK_SPLIT_ESB
module-str = ZMK_SPLIT_ESB
source "subsys/logging/Kconfig.template.log_config"

endif # ZMK_SPLIT_ESB

# The controller's own defaults are 0 ticker ids and 5 event types. The hosted
# receiver needs one ticker id and no proprietary HCI events, but a range of 0
# doesn't compile (the LISTIFY in ll_sw/lll.h leaves a stray comma), so keep 1.
config BT_CTLR_USER_TICKER_ID_RANGE
    default 1 if ZMK_SPLIT_ESB_HOSTED_PRX

config BT_CTLR_USER_EVT_RANGE
    default 1 if ZMK_SPLIT_ESB_HOSTED_PRX
```

## dts/bindings/sensor/zmk,split-peripheral-battery.yaml
```yaml
# Copyright (c) 2026 The ZMK Contributors
# SPDX-License-Identifier: MIT

description: |
  Battery "sensor" for a split central without a battery of its own, such as
  a dongle. Reports the lowest state of charge among its peripherals, so
  pointing zmk,battery at it makes hosts see the lowest half's level.

compatible: "zmk,split-peripheral-battery"
```
